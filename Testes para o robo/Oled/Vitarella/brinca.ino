#include <Wire.h>
#include <Adafruit_GFX.h>
#include <Adafruit_SSD1306.h>

#define W 128
#define H 64

Adafruit_SSD1306 display(W, H, &Wire, -1);

const unsigned char abeia [] PROGMEM = {
	0x00, 0x00, 0x00, 0x00, 0x00, 0x00, 0x00, 0x00, 0x00, 0x00, 0x00, 0x00, 0x00, 0x00, 0x00, 0x00, 
	0x00, 0x00, 0x00, 0x00, 0x00, 0x00, 0x00, 0x00, 0x00, 0x00, 0x00, 0x00, 0x00, 0x00, 0x00, 0x00, 
	0x00, 0x00, 0x00, 0x00, 0x00, 0x00, 0x00, 0x00, 0x00, 0x00, 0x00, 0x00, 0x00, 0x00, 0x00, 0x00, 
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	0x00, 0x00, 0x00, 0x00, 0x00, 0x00, 0x00, 0x00, 0x00, 0x00, 0x00, 0x00, 0x00, 0x00, 0x00, 0x00
};

void setup() {
  	display.begin(SSD1306_SWITCHCAPVCC, 0x3C);
  	display.clearDisplay();
  	display.setTextColor(WHITE);
  	Serial.begin(9600);

  	for(int i = 0; i < 225*3; i+=36) {
    	display.clearDisplay();
    	display.drawBitmap(0, sin(i * PI/180)*6, abeia, W, H, WHITE);
    	display.display();
    	delay(100);
  	}

  	delay(3000);

	display.clearDisplay();
	display.drawFastVLine(32, 16, 16, WHITE);
	display.drawFastVLine(48, 16, 16, WHITE);
	for(int i = 0; i < 180; i++)
		display.drawPixel(40 + cos(i*PI/180)*15, 32 + sin(i*PI/180)*15, WHITE);
	display.display();

	delay(2000);

	//display.clearDisplay();

	for(int i = 0, j = 0; i < 360/10; i++) { //j=sin(i)
		if(j < 32)
			display.drawPixel(64 + j++, 16 + sin(32*i*PI/180)*4, WHITE);
		display.display();
		Serial.println(i);
		delay(100);
	}
	display.setCursor(96, 12);
	display.print("erda");
	display.display();
	delay(250);
	display.fillRect(96, 0, 32, 64, BLACK);
	display.display();
	delay(100);
	display.setCursor(96, 12);
	display.print("eu");
	display.setCursor(64, 20);
	display.print("deu s");
	display.display();
	delay(2000);

	for(int i = 0; i < 180; i++)
		display.drawPixel(82 + cos(i*PI/180)*24, 56 + sin(i*PI/180)*8, WHITE); //64+(deu*6)
	display.display();
	delay(2000);

	for(int i = 180; i < 360; i++)
		display.drawPixel(82 + cos(i*PI/180)*24, 56 + sin(i*PI/180)*8, WHITE); //64+(deu*6)
	display.fillCircle(82, 56, 4, WHITE);
	display.display();
	delay(1000);

	display.fillCircle(82, 56, 4, BLACK);
	display.fillCircle(82-8, 56, 4, WHITE);
	display.display();
	delay(500);

	display.fillCircle(82-8, 56, 4, BLACK);
	display.fillCircle(82, 56, 4, WHITE);
	display.display();
	delay(500);

	display.fillCircle(82, 56, 4, BLACK);
	display.fillCircle(82, 56-4, 4, WHITE);
	display.display();
	delay(500);

	display.fillCircle(82, 56-4, 4, BLACK);
	display.fillCircle(82, 56, 4, WHITE);
	display.display();

	for(int i = 4; i < 128; i++) {
		display.fillCircle(82, 56, i, WHITE);
		display.display();
		delay(1);
	}

	delay(2000);
	display.setTextColor(BLACK);
	display.setCursor(W/2 - 9, H/2);
	display.print("ola");
	display.display();
}

void loop() {
}